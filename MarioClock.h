#ifndef MARIOCLOCK_H
#define MARIOCLOCK_H

#include <Arduino.h>
#include <ESP32-HUB75-MatrixPanel-I2S-DMA.h>

// Tell this file that dma_display exists in your main sketch
extern MatrixPanel_I2S_DMA *dma_display;
extern bool currentIsNight;
extern uint16_t applyNightVision(uint16_t color);

namespace MarioClock {

    // --- Color Palette & MASK ---
    const uint16_t SKY_COLOR = 0x000E;
    const uint16_t _MASK     = SKY_COLOR;
    const uint16_t M_RED     = 0xF801;
    const uint16_t M_SKIN    = 0xfd28;
    const uint16_t M_SHOES   = 0xC300;
    const uint16_t M_SHIRT   = 0x7BCF;
    const uint16_t M_HAIR    = 0x0000;
    const uint16_t M_WHITE   = 0xFFFF; // For clouds
    const uint16_t M_BLACK   = 0x0000; // For text

    // --- Custom Font Data ---
    const uint8_t FONT_BITMAPS[] = {
        0x00, 0xFF, 0xEC, 0x30, 0xDE, 0xF6, 0x6C, 0xDB, 0xFB, 0x6F, 0xED, 0x9B, 0x00, 0x10, 0xFB, 0x83,
        0xE0, 0xFF, 0x84, 0x00, 0xC7, 0x9C, 0x71, 0xC7, 0x1C, 0xF1, 0x80, 0x61, 0xA3, 0x5B, 0xED, 0x99,
        0x9D, 0x80, 0xFC, 0x36, 0xCC, 0xC6, 0x30, 0xC6, 0x33, 0x36, 0xC0, 0x6C, 0x73, 0xF9, 0xC6, 0xC0,
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        0x30, 0xFF, 0xFC, 0xC6, 0x63, 0x66, 0xC0, 0x71, 0x74, 0x70
    };

    // --- Assets ---
    const uint16_t GROUND[] = {
        0xE2C2, 0xF6B6, 0xF6B6, 0xF6B6, 0x0000, 0xE2C2, 0xF6B6, 0xE2C2, 0xF6B6, 0xE2C2, 0xE2C2, 0xE2C2, 0x0000, 0xF6B6, 0xE2C2, 0x0000,
        0xF6B6, 0xE2C2, 0xE2C2, 0xE2C2, 0x0000, 0xE2C2, 0x0000, 0xE2C2, 0x0000, 0xE2C2, 0xE2C2, 0xE2C2, 0x0000, 0xF6B6, 0xF6B6, 0x0000,
        0xF6B6, 0x0000, 0x0000, 0xE2C2, 0x0000, 0xF6B6, 0xE2C2, 0x0000, 0xF6B6, 0xF6B6, 0xF6B6, 0x0000, 0xF6B6, 0xE2C2, 0xE2C2, 0x0000,
        0xF6B6, 0xE2C2, 0xE2C2, 0xF6B6, 0xE2C2, 0xE2C2, 0xE2C2, 0x0000, 0xE2C2, 0x0000, 0x0000, 0xF6B6, 0x0000, 0x0000, 0x0000, 0xE2C2
    };

    const uint16_t BLOCK[] = {
        _MASK, 0x9A40, 0x9A40, 0x9A40, 0x9A40, 0x9A40, 0x9A40, 0x9A40, 0x9A40, 0x9A40, 0x9A40, 0x9A40, 0x9A40, 0x9A40, 0x9A40, 0x9A40,
        0x9A40, 0x9A40, _MASK, 0x9A40, 0xE4E4, 0xE4E4, 0xE4E4, 0xE4E4, 0xE4E4, 0xE4E4, 0xE4E4, 0xE4E4, 0xE4E4, 0xE4E4, 0xE4E4, 0xE4E4,
        0xE4E4, 0xE4E4, 0xE4E4, 0xE4E4, 0xE4E4, 0x0000, 0x9A40, 0xE4E4, 0x0000, 0x0000, 0xE4E4, 0xE4E4, 0xE4E4, 0xE4E4, 0xE4E4, 0xE4E4,
        0xE4E4, 0xE4E4, 0xE4E4, 0xE4E4, 0xE4E4, 0x0000, 0x0000, 0xE4E4, 0x0000, 0x9A40, 0xE4E4, 0x0000, 0x0000, 0xE4E4, 0xE4E4, 0xE4E4,
        0xE4E4, 0xE4E4, 0xE4E4, 0xE4E4, 0xE4E4, 0xE4E4, 0xE4E4, 0xE4E4, 0x0000, 0x0000, 0xE4E4, 0x0000, 0x9A40, 0xE4E4, 0xE4E4, 0xE4E4,
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        0x0000, 0xE4E4, 0x0000, 0x9A40, 0xE4E4, 0xE4E4, 0xE4E4, 0xE4E4, 0xE4E4, 0xE4E4, 0xE4E4, 0xE4E4, 0xE4E4, 0xE4E4, 0xE4E4, 0xE4E4,
        0xE4E4, 0xE4E4, 0xE4E4, 0xE4E4, 0xE4E4, 0x0000, _MASK, 0x0000, 0x0000, 0x0000, 0x0000, 0x0000, 0x0000, 0x0000, 0x0000, 0x0000
    };

    const uint16_t BUSH[] = {
        _MASK, _MASK, _MASK, _MASK, _MASK, _MASK, _MASK, _MASK, 0x0000, 0x0000, _MASK, _MASK, _MASK, _MASK, _MASK, _MASK,
        _MASK, 0x0000, 0x0000, _MASK, _MASK, _MASK, _MASK, _MASK, _MASK, _MASK, _MASK, _MASK, 0x0000, 0xBFE3, 0xBFE3, 0x0000,
        _MASK, 0x0000, _MASK, _MASK, _MASK, 0x0000, 0xBFE3, 0xBFE3, 0x0000, _MASK, _MASK, _MASK, _MASK, _MASK, _MASK, _MASK,
        0x0000, 0xBFE3, 0xBFE3, 0xBFE3, 0xBFE3, 0x0000, 0xBFE3, 0x0000, _MASK, 0x0000, 0xBFE3, 0xBFE3, 0xBFE3, 0xBFE3, 0x0000, _MASK,
        _MASK, _MASK, _MASK, _MASK, _MASK, 0x0000, 0xBFE3, 0xBFE3, 0xBFE3, 0x0560, 0xBFE3, 0xBFE3, 0x0000, _MASK, 0x0000, 0xBFE3,
        0xBFE3, 0xBFE3, 0x0560, 0xBFE3, _MASK, _MASK, _MASK, _MASK, _MASK, 0x0000, 0xBFE3, 0x0560, 0x0560, 0xBFE3, 0xBFE3, 0x0560,
        0xBFE3, 0xBFE3, 0x0000, 0xBFE3, 0x0560, 0x0560, 0xBFE3, 0xBFE3, 0x0560, _MASK, _MASK, _MASK, 0x0000, 0x0000, 0xBFE3, 0x0560,
        0xBFE3, 0xBFE3, 0xBFE3, 0xBFE3, 0xBFE3, 0xBFE3, 0xBFE3, 0xBFE3, 0x0560, 0xBFE3, 0xBFE3, 0xBFE3, 0xBFE3, 0xBFE3, _MASK, _MASK,
        0x0000, 0xBFE3, 0xBFE3, 0xBFE3, 0xBFE3, 0xBFE3, 0xBFE3, 0xBFE3, 0xBFE3, 0xBFE3, 0xBFE3, 0xBFE3, 0xBFE3, 0xBFE3, 0xBFE3, 0xBFE3,
        0xBFE3, 0xBFE3, 0xBFE3, _MASK, _MASK, 0x0000, 0xBFE3, 0xBFE3, 0xBFE3, 0xBFE3, 0xBFE3, 0xBFE3, 0xBFE3, 0xBFE3, 0xBFE3, 0xBFE3,
        0xBFE3, 0xBFE3, 0xBFE3, 0xBFE3, 0xBFE3, 0xBFE3, 0xBFE3, 0xBFE3, _MASK, 0x0000, 0xBFE3, 0xBFE3, 0xBFE3, 0xBFE3, 0xBFE3, 0xBFE3,
        0xBFE3, 0xBFE3, 0xBFE3, 0xBFE3, 0xBFE3, 0xBFE3, 0xBFE3, 0xBFE3, 0xBFE3, 0xBFE3, 0xBFE3, 0xBFE3, 0xBFE3
    };

    const uint16_t MARIO_IDLE[] = {
        _MASK, _MASK, _MASK, M_RED, M_RED, M_RED, M_RED, M_RED, M_RED, _MASK, _MASK, _MASK, _MASK,
        _MASK, _MASK, M_RED, M_RED, M_RED, M_RED, M_RED, M_RED, M_RED, M_RED, M_RED, M_RED, _MASK,
        _MASK, _MASK, M_HAIR, M_HAIR, M_HAIR, M_SKIN, M_SKIN, M_HAIR, M_SKIN, M_SKIN, _MASK, _MASK,
        _MASK, _MASK, M_HAIR, M_SKIN, M_HAIR, M_SKIN, M_SKIN, M_SKIN, M_HAIR, M_SKIN, M_SKIN, M_SKIN, M_SKIN, _MASK,
        _MASK, M_HAIR, M_SKIN, M_HAIR, M_HAIR, M_SKIN, M_SKIN, M_SKIN, M_HAIR, M_SKIN, M_SKIN, M_SKIN, M_SKIN, _MASK,
        M_HAIR, M_HAIR, M_SKIN, M_SKIN, M_SKIN, M_SKIN, M_HAIR, M_HAIR, M_HAIR, M_HAIR, M_HAIR, _MASK, _MASK, 
        _MASK, _MASK, M_SKIN, M_SKIN, M_SKIN, M_SKIN, M_SKIN, M_SKIN, M_SKIN, M_SKIN, _MASK, _MASK, _MASK,
        _MASK, M_SHIRT, M_SHIRT, M_RED, M_SHIRT, M_SHIRT, M_SHIRT, M_SHIRT, _MASK, _MASK, _MASK, _MASK, _MASK, 
        M_SHIRT, M_SHIRT, M_SHIRT, M_RED, M_SHIRT, M_SHIRT, M_RED, M_SHIRT, M_SHIRT, M_SHIRT, M_SHIRT, _MASK, 
        M_SHIRT, M_SHIRT, M_SHIRT, M_SHIRT, M_RED, M_RED, M_RED, M_RED, M_SHIRT, M_SHIRT, M_SHIRT, M_SHIRT, M_SHIRT, 
        M_SKIN, M_SKIN, M_SHIRT, M_RED, M_SKIN, M_RED, M_RED, M_SKIN, M_RED, M_SHIRT, M_SKIN, M_SKIN, M_SKIN, 
        M_SKIN, M_SKIN, M_SKIN, M_RED, M_RED, M_RED, M_RED, M_RED, M_RED, M_SKIN, M_SKIN, M_SKIN, M_SKIN, 
        M_SKIN, M_SKIN, M_RED, M_RED, M_RED, M_RED, M_RED, M_RED, M_RED, M_RED, M_SKIN, M_SKIN, M_SKIN,
        _MASK, _MASK, M_RED, M_RED, M_RED, M_RED, _MASK, M_RED, M_RED, M_RED, M_RED, _MASK, _MASK,
        _MASK, M_SHOES, M_SHOES, M_SHOES, M_SHOES, _MASK, _MASK, _MASK, M_SHOES, M_SHOES, M_SHOES, M_SHOES, _MASK, 
        M_SHOES, M_SHOES, M_SHOES, M_SHOES, M_SHOES, _MASK, _MASK, _MASK, M_SHOES, M_SHOES, M_SHOES, M_SHOES, M_SHOES
    };

    const uint16_t MARIO_JUMP[] = {
        _MASK, _MASK, _MASK, _MASK, _MASK, _MASK, _MASK, _MASK, _MASK, _MASK, _MASK, _MASK, _MASK, M_SKIN, M_SKIN, M_SKIN, M_SKIN, 
        _MASK, _MASK, _MASK, _MASK, _MASK, _MASK, M_RED, M_RED, M_RED, M_RED, M_RED, M_RED, _MASK, M_SKIN, M_SKIN, M_SKIN, M_SKIN, 
        _MASK, _MASK, _MASK, _MASK, _MASK, M_RED, M_RED, M_RED, M_RED, M_RED, M_RED, M_RED, M_RED, M_RED, M_SKIN, M_SKIN, M_SKIN, 
        _MASK, _MASK, _MASK, _MASK, _MASK, M_HAIR, M_HAIR, M_HAIR, M_SKIN, M_SKIN, M_HAIR, M_SKIN, M_SKIN, M_SHIRT, M_SHIRT, M_SHIRT, M_SHIRT, 
        _MASK, _MASK, _MASK, _MASK, M_HAIR, M_SKIN, M_HAIR, M_SKIN, M_SKIN, M_SKIN, M_HAIR, M_SKIN, M_SKIN, M_SHIRT, M_SHIRT, M_SHIRT, M_SHIRT, 
        _MASK, _MASK, _MASK, _MASK, M_HAIR, M_SKIN, M_HAIR, M_HAIR, M_SKIN, M_SKIN, M_SKIN, M_HAIR, M_SKIN, M_SKIN, M_SKIN, M_SHIRT, M_SHIRT, 
        _MASK, _MASK, _MASK, _MASK, M_HAIR, M_HAIR, M_SKIN, M_SKIN, M_SKIN, M_SKIN, M_HAIR, M_HAIR, M_HAIR, M_HAIR, M_SHIRT, M_SHIRT, _MASK, 
        _MASK, _MASK, _MASK, _MASK, _MASK, _MASK, M_SKIN, M_SKIN, M_SKIN, M_SKIN, M_SKIN, M_SKIN, M_SKIN, M_SHIRT, M_SHIRT, _MASK, _MASK, _MASK, 
        _MASK, M_SHIRT, M_SHIRT, M_SHIRT, M_SHIRT, M_SHIRT, M_RED, M_SHIRT, M_SHIRT, M_SHIRT, M_RED, M_SHIRT, M_SHIRT, _MASK, _MASK, _MASK, 
        _MASK, M_SHIRT, M_SHIRT, M_SHIRT, M_SHIRT, M_SHIRT, M_SHIRT, M_SHIRT, M_RED, M_SHIRT, M_SHIRT, M_SHIRT, M_RED, M_RED, _MASK, M_SHOES, M_SHOES, 
        M_SKIN, M_SKIN, M_SHIRT, M_SHIRT, M_SHIRT, M_SHIRT, M_SHIRT, M_SHIRT, M_RED, M_RED, M_RED, M_RED, M_RED, M_RED, _MASK, M_SHOES, M_SHOES, 
        M_SKIN, M_SKIN, M_SKIN, M_SKIN, M_RED, M_RED, M_SHIRT, M_RED, M_RED, M_SKIN, M_RED, M_RED, M_SKIN, M_RED, M_SHOES, M_SHOES, M_SHOES, 
        _MASK, M_SKIN, M_SKIN, M_SHOES, M_RED, M_RED, M_RED, M_RED, M_RED, M_RED, M_RED, M_RED, M_RED, M_RED, M_SHOES, M_SHOES, M_SHOES, 
        _MASK, _MASK, M_SHOES, M_SHOES, M_SHOES, M_RED, M_RED, M_RED, M_RED, M_RED, M_RED, M_RED, M_RED, M_RED, M_SHOES, M_SHOES, M_SHOES, 
        _MASK, M_SHOES, M_SHOES, M_SHOES, M_RED, M_RED, M_RED, M_RED, M_RED, M_RED, M_RED, M_RED, _MASK, _MASK, _MASK, _MASK, _MASK, 
        _MASK, M_SHOES, M_SHOES, _MASK, M_RED, M_RED, M_RED, M_RED, M_RED, _MASK, _MASK, _MASK, _MASK, _MASK, _MASK, _MASK, _MASK
    };

    // --- State Variables ---
    int lastMinute = -1;
    unsigned long lastFrameTime = 0;
    
    int mario_x = 23;
    int mario_y = 40;
    bool mario_isJumping = false;
    bool mario_up = true;

    int hourBlock_x = 13;
    int hourBlock_y = 8;
    int hourBlock_startY = 8;
    int hourBlock_offset = 0;
    bool hourBlock_isHit = false;
    bool hourBlock_up = true;

    int minBlock_x = 32;
    int minBlock_y = 8;
    int minBlock_startY = 8;
    int minBlock_offset = 0;
    bool minBlock_isHit = false;
    bool minBlock_up = true;

    int cloud1_x = 0;
    int cloud1_y = 21;
    int cloud2_x = 51;
    int cloud2_y = 7;

    // ==========================================
    // Create a 64x64 off-screen canvas
    // ==========================================
    GFXcanvas16 clockCanvas(64, 64);

    // --- Font Helper ---
    bool getGlyphInfo(char c, uint8_t &offset, uint8_t &width, uint8_t &x_offset) {
        switch(c) {
            case '0': offset = 64;  width = 7; x_offset = 0; return true;
            case '1': offset = 71;  width = 5; x_offset = 1; return true;
            case '2': offset = 76;  width = 7; x_offset = 0; return true;
            case '3': offset = 83;  width = 7; x_offset = 0; return true;
            case '4': offset = 90;  width = 7; x_offset = 0; return true;
            case '5': offset = 97;  width = 7; x_offset = 0; return true;
            case '6': offset = 104; width = 7; x_offset = 0; return true;
            case '7': offset = 111; width = 7; x_offset = 0; return true;
            case '8': offset = 118; width = 7; x_offset = 0; return true;
            case '9': offset = 125; width = 7; x_offset = 0; return true;
            case '?': offset = 150; width = 7; x_offset = 0; return true;
            default: return false;
        }
    }

    void drawMarioText(String text, int x, int y, uint16_t color) {
        int cursorX = x;
        for (int i = 0; i < text.length(); i++) {
            char c = text.charAt(i);
            uint8_t offset, width, x_offset_char;
            
            if (!getGlyphInfo(c, offset, width, x_offset_char)) {
                cursorX += 8; 
                continue;
            }

            int height = 7;
            int y_offset = -6;
            int x_advance = 8;

            for (int row = 0; row < height; row++) {
                int destY = y + y_offset + row;
                int rowStart = row * width;
                
                for (int col = 0; col < width; col++) {
                    int destX = cursorX + x_offset_char + col;
                    int bitIndex = rowStart + col;
                    
                    int byteIndex = offset + (bitIndex / 8);
                    int bitShift = 7 - (bitIndex % 8);
                    
                    if ((FONT_BITMAPS[byteIndex] >> bitShift) & 1) {
                        clockCanvas.drawPixel(destX, destY, color);
                    }
                }
            }
            cursorX += x_advance;
        }
    }

    void drawSprite(int x, int y, int width, int height, const uint16_t *data) {
        for (int i = 0; i < width * height; i++) {
            uint16_t color = data[i];
            if (color != _MASK) {
                int px = x + (i % width);
                int py = y + (i / width);
                clockCanvas.drawPixel(px, py, color);
            }
        }
    }

    void drawClouds(int x, int y) {
        clockCanvas.fillRect(x + 4, y, 16, 8, M_WHITE);
        clockCanvas.fillRect(x + 2, y + 2, 20, 6, M_WHITE);
        clockCanvas.fillRect(x, y + 4, 24, 4, M_WHITE);
    }

// --- Main Update and Render Loop ---
    void drawClockFrame(int hours, int minutes) {
        unsigned long now = millis();

        // 1. Check for minute changes
        if (lastMinute != -1 && lastMinute != minutes) {
            if (!mario_isJumping) {
                mario_isJumping = true;
                mario_up = true;
                mario_y = 40;
            }
        }
        lastMinute = minutes;

        // 2. ONLY render and calculate math every 50ms (20 FPS)
        if (now - lastFrameTime > 50) {
            
            // --- Update Animations ---
            cloud1_x -= 1; if (cloud1_x < -24) cloud1_x = 64;
            cloud2_x -= 1; if (cloud2_x < -24) cloud2_x = 64;

            if (mario_isJumping) {
                mario_y += (mario_up ? -3 : 3);
                if (mario_up && mario_y <= 26) {
                    mario_up = false;
                    hourBlock_isHit = true; hourBlock_up = true;
                    minBlock_isHit = true;  minBlock_up = true;
                }
                if (!mario_up && mario_y >= 40) {
                    mario_isJumping = false;
                    mario_y = 40;
                }
            }

            if (hourBlock_isHit) {
                hourBlock_offset += (hourBlock_up ? -2 : 2);
                if (hourBlock_up && hourBlock_offset <= -4) hourBlock_up = false;
                if (!hourBlock_up && hourBlock_offset >= 0) {
                    hourBlock_offset = 0; hourBlock_isHit = false;
                }
            }
            
            if (minBlock_isHit) {
                minBlock_offset += (minBlock_up ? -2 : 2);
                if (minBlock_up && minBlock_offset <= -4) minBlock_up = false;
                if (!minBlock_up && minBlock_offset >= 0) {
                    minBlock_offset = 0; minBlock_isHit = false;
                }
            }

            // --- Render the Canvas ---
            clockCanvas.fillScreen(SKY_COLOR);

            drawClouds(cloud1_x, cloud1_y);
            drawClouds(cloud2_x, cloud2_y);
            
            for (int gx = 0; gx < 64; gx += 8) {
                drawSprite(gx, 56, 8, 8, GROUND);
            }

            drawSprite(43, 47, 21, 9, BUSH);
            drawSprite(hourBlock_x, hourBlock_startY + hourBlock_offset, 19, 19, BLOCK);
            drawSprite(minBlock_x, minBlock_startY + minBlock_offset, 19, 19, BLOCK);
            
            String hh = (hours < 10 ? "0" : "") + String(hours);
            String mm = (minutes < 10 ? "0" : "") + String(minutes);
            drawMarioText(hh, hourBlock_x + 2, hourBlock_startY + hourBlock_offset + 12, M_BLACK);
            drawMarioText(mm, minBlock_x + 2, minBlock_startY + minBlock_offset + 12, M_BLACK);

            if (mario_isJumping) {
                drawSprite(mario_x, mario_y, 17, 16, MARIO_JUMP);
            } else {
                drawSprite(mario_x, mario_y, 13, 16, MARIO_IDLE);
            }

            // --- Apply Night Vision ---
            if (currentIsNight) {
                uint16_t* buf = clockCanvas.getBuffer();
                for (int i = 0; i < 64 * 64; i++) {
                    buf[i] = applyNightVision(buf[i]);
                }
            }
            
            // --- Centered Offset Calculation ---
            int matrixW = dma_display->width();
            int matrixH = dma_display->height();
            int offsetX = (matrixW - 64) / 2;
            int offsetY = (matrixH - 64) / 2;
            if (offsetX < 0) offsetX = 0;
            if (offsetY < 0) offsetY = 0;

            // Clear surrounding borders if panel size is larger than 64x64
            if (matrixW > 64 || matrixH > 64) {
                dma_display->fillScreen(0);
            }

            // --- Push Centered to Matrix ---
            dma_display->drawRGBBitmap(offsetX, offsetY, clockCanvas.getBuffer(), 64, 64);

            lastFrameTime = now;
        }
    }
}

#endif